/**
  *******************************************************************
  * Chip: STM32F103C6
  * NOTE: This file is generated by CoIDE and Included by *link.ld
  *       It is used to describe which memory regions may be used
  *       by the linker.
  *******************************************************************
  * Internal memory map
  *   Region      Start           Size
  *   flash0      0x08000000      0x00008000
  *   sram0       0x20000000      0x00002800
  *******************************************************************
*/

MEMORY
{
	rom (rx)  : ORIGIN = 0x08000000, LENGTH = 0x00008000
	ram (rwx) : ORIGIN = 0x20000000, LENGTH = 0x00002800
}

_eram = 0x20000000 + 0x00002800;